#include <Adafruit_NeoPixel.h>
#include <avr/pgmspace.h>

// Parameter 1 = number of pixels in strip
// Parameter 2 = pin number (most are valid)
// Parameter 3 = pixel type flags, add together as needed:
//   NEO_RGB     Pixels are wired for RGB bitstream
//   NEO_GRB     Pixels are wired for GRB bitstream
//   NEO_KHZ400  400 KHz bitstream (e.g. FLORA pixels)
//   NEO_KHZ800  800 KHz bitstream (e.g. High Density LED strip)
Adafruit_NeoPixel strip = Adafruit_NeoPixel(10, 16, NEO_GRB + NEO_KHZ800);

const String led_chars_index =" !\"#$%&'()*+,-./0123456789:;>=<?@ABCDEFGHIJKLMNOPQRSTUVWXYZ[ ]^_`abcdefghijklmnopqrstuvwxyz{|}~~";

// defines 8x8 ascii characters 0x20-0x7F (32-127)
uint16_t PROGMEM font[96][8] = {
        {0x00,0x00,0x00,0x00,0x00,0x00,0x00,0x00}, //    0
        {0x00,0x60,0xfa,0xfa,0x60,0x00,0x00,0x00}, // !
        {0x00,0xe0,0xe0,0x00,0xe0,0xe0,0x00,0x00}, // "
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        {0x1e,0x3e,0x62,0xc2,0x62,0x3e,0x1e,0x00}, //    95
};


uint32_t pattern1[] =   {0x7F7F00,0x7F7F00,0x7F7F00,0x7F7F00,0x7F7F00,0x7F7F00,0x7F7F00,0x7F7F00,0x7F7F00,0x7F7F00,0x007F00,0x007F00,0x007F00,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0x00007F,0x00007F}  ;
uint32_t pattern2[] =   {0xFF0000,0xFF0000,0xFF0000,0xFF0000,0xFF0000,0xFF0000,0xFF0000,0xFF0000,0xFF0000,0xFF0000,0x00FF00,0x00FF00,0x00FF00,0x00FF00,0x00FF00,0x00FF00,0x00FF00,0x00FF00,0x00FF00,0x00FF00,0x0000FF,0x0000FF,0x0000FF,0x0000FF,0x0000FF,0x0000FF,0x0000FF,0x0000FF,0x0000FF,0x0000FF,};


void setup() 
{
  strip.begin();
  strip.show(); // Initialize all pixels to 'off'
}

void loop() 
{
  
  text_POV(1, "Peter Black");
  POV(3000, 1);
  // Some example procedures showing how to display to the pixels:
  colorWipe(strip.Color(255, 0, 0), 50); // Red
  colorWipe(strip.Color(0, 255, 0), 50); // Green
  colorWipe(strip.Color(0, 0, 255), 50); // Blue
  rainbow(20);
  rainbowCycle(20);
}






//////////////////////////////////////////////////////////////////////
// byte data=pgm_read_byte (&led_chars[led_chars_index.indexOf(Message[fxVars[idx][10]].charAt(fxVars[idx][9]))][fxVars[idx][5]]);  //  

void text_POV(int wait, String text)
{
  
     int count = 0;
    int frames_per_letter = 8;
    //int letter = 0;
    int leds_to_write = 10; //height of leds
  
  for (uint16_t current_letter = 0; current_letter < text.length(); current_letter++) //
  {
    for(uint16_t j=0; j < frames_per_letter; j++) //how many frames are in each letter.
    {

      for(uint16_t i = 0; i < leds_to_write; i++) // set the pixels for 1 frame
      {
         byte data = pgm_read_byte (&font[led_chars_index.indexOf(text.charAt(current_letter))][j]);  //  

         if((data>>i)&1)
         {
           strip.setPixelColor(i, Wheel(count));
         }
         else 
         {
           strip.setPixelColor(i, 0,0,0);

         }
         count++;
        Serial.println(data, BIN);
        //shift + 8;
      }

      strip.show();
      
      /*
      for(uint16_t m=0; m<strip.numPixels(); m++) // set the pixels for 1 frame
      {
                 strip.setPixelColor(m, 0,0,0);
      }
      
      strip.show();
*/
      
      
      delay(wait);
    }
  }
}




void POV(uint16_t cycles, int wait) 
{
  
  //uint16_t frames = sizeof(pattern1)/sizeof(pattern1[0];// This will tell us how many times to write the strip if there are 30 items
  //frames = frames / 10;                                 // in the strip then 30 / 10 = 3 frames of information. 
    
    uint16_t frames = 3;
    
  
  for (uint16_t k = 0; k < cycles; k++) // how many times we want to repeat our pattern
  {
    uint16_t pattern_posistion = 0;   
    for(uint16_t j=0; j < frames; j++) //how many frames are in each pattern.
    {
       // start test for refresh rate
      // unsigned long start = micros();

      for(uint16_t i=0; i<strip.numPixels(); i++) // set the pixels for 1 frame
      {
         strip.setPixelColor(i, pattern2[pattern_posistion]);
         Serial.println(pattern2[pattern_posistion], BIN);
         pattern_posistion++;
      }
      
      //test for refresh rate ---- clocked at 80 to 84 micro seconds per frame!!
     // unsigned long end = micros();
     // unsigned long delta = end - start;
     // Serial.println(delta);
      
      strip.show();
      delay(wait);
    }
    pattern_posistion = 0;
  }
}



// Fill the dots one after the other with a color
void colorWipe(uint32_t c, uint8_t wait) {
  for(uint16_t i=0; i<strip.numPixels(); i++) {
      strip.setPixelColor(i, c);
      strip.show();
      delay(wait);
  }
}

void rainbow(uint8_t wait) {
  uint16_t i, j;

  for(j=0; j<256; j++) {
    for(i=0; i<strip.numPixels(); i++) {
      strip.setPixelColor(i, Wheel((i+j) & 255));
    }
    strip.show();
    delay(wait);
  }
}

// Slightly different, this makes the rainbow equally distributed throughout
void rainbowCycle(uint8_t wait) {
  uint16_t i, j;

  for(j=0; j<256*5; j++) { // 5 cycles of all colors on wheel
    for(i=0; i< strip.numPixels(); i++) {
      strip.setPixelColor(i, Wheel(((i * 256 / strip.numPixels()) + j) & 255));
    }
    strip.show();
    delay(wait);
  }
}

// Input a value 0 to 255 to get a color value.
// The colours are a transition r - g - b - back to r.
uint32_t Wheel(byte WheelPos) {
  if(WheelPos < 85) {
   return strip.Color(WheelPos * 3, 255 - WheelPos * 3, 0);
  } else if(WheelPos < 170) {
   WheelPos -= 85;
   return strip.Color(255 - WheelPos * 3, 0, WheelPos * 3);
  } else {
   WheelPos -= 170;
   return strip.Color(0, WheelPos * 3, 255 - WheelPos * 3);
  }
}
